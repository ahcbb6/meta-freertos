## conf/distro/freertos.conf
```bitbake
DISTRO = "freertos"
DISTRO_NAME = "FreeRTOS"
DISTRO_VERSION = "1.0"

TCLIBC = "newlib"

#INHIBIT_SYSROOT_STRIP="1"

INHERIT += "uninative"
require conf/distro/include/yocto-uninative.inc

# We're building baremetal, we dont need the default DISTRO_FEATURES from oe-core/poky
DISTRO_FEATURES_OPTED_OUT = "3g acl alsa bluetooth debuginfod ext2 gobject-introspection-data ipv4 ipv6 multiarch nfc nfs opengl pci ptest pulseaudio seccomp vfat vulkan wayland wifi x11 xattr zeroconf"
```

## conf/distro/poky-freertos.conf
```bitbake
DISTRO = "poky-freertos"
DISTRO_NAME = "Poky FreeRTOS"
DISTRO_VERSION = "1.0"

TCLIBC = "newlib"
TCLIBCAPPEND = ""

#INHIBIT_SYSROOT_STRIP="1"

BB_DANGLINGAPPENDS_WARNONLY = "1"
```

## conf/layer.conf
```bitbake
# We have a conf and classes directory, add to BBPATH
BBPATH .= ":${LAYERDIR}"

# We have recipes-* directories, add to BBFILES
BBFILES += "${LAYERDIR}/recipes-*/*/*.bb \
	${LAYERDIR}/recipes-*/*/*.bbappend"

BBFILE_COLLECTIONS += "meta-freertos"
BBFILE_PATTERN_meta-freertos = "^${LAYERDIR}/"
BBFILE_PRIORITY_meta-freertos = "6"

LAYERDEPENDS_meta-freertos = "core"

LAYERSERIES_COMPAT_meta-freertos = "langdale"


# Uncomment the following to enable the default multiconfig build
# Add additional dummy x86-64 multiconfig that builds Linux along with
# a dependency to build for both architectures.
# BBMULTICONFIG = "dummy-x86-64"
# do_image[mcdepends] = "multiconfig:dummy-x86-64::freertos-demo-local:do_image"
```

## conf/machine/stm32f446.conf
```bitbake
#@TYPE: Machine
#@NAME: STM32F446
#@DESCRIPTION: Machine configuration for 32 bit ARM Cortex-M4F

DEFAULTTUNE ?= "cortexm4thf-vfp"

TUNEVALID[cortexm4f] = "Enable Cortex-M4F specific processor optimizations"
TUNE_CCARGS .= "${@bb.utils.contains('TUNE_FEATURES', 'cortexm4f', ' -mcpu=cortex-m4', '', d)}"

# vfp4spd16 is not in the oe-core inc files
TUNEVALID[vfpv4spd16] = "Enable Vector Floating Point Version 4, Single Precision. with 16 registers (fpv4-sp-d16) unit."
TUNE_CCARGS_MFPU .= "${@bb.utils.contains('TUNE_FEATURES', 'vfpv4spd16', 'fpv4-sp-d16', '', d)}"

require conf/machine/include/arm/armv7m/tune-cortexm4.inc


AVAILTUNES                            += "cortexm4thf-vfp"
ARMPKGARCH:tune-cortexm4thf-vfp               = "cortexm4"
TUNE_FEATURES:tune-cortexm4thf-vfp            = "${TUNE_FEATURES:tune-cortexm4} thumb callconvention-hard vfpv4spd16"
PACKAGE_EXTRA_ARCHS:tune-cortexm4thf-vfp      = "${PACKAGE_EXTRA_ARCHS:tune-cortexm4} cortexm4t2hf-fpv4-spd16"
```
